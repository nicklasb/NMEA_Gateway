## main/Kconfig.projbuild
```kconfig
# Kconfig file for the NMEA Gateway project
menu "NMEA Gateway config"
    config CAN_TX_PIN
        int "GPIO of NMEA2000/CAN TX"
        default 32
        help
            The GPIO of the NMEA2000/CAN transmitter
    
    config CAN_RX_PIN
        int "GPIO of NMEA2000/CAN RX"
        default 34
        help
            The GPIO of the NMEA2000/CAN receiver
    config SIMULATE_AP
        bool "Simulate an active NMEA network with a pilot (in NMEA.hdg topic)"
        help
            This is used during testing to simulate the response of the auto pilot.
endmenu
```

## src/Kconfig.projbuild
```kconfig
# Kconfig file for the NMEA Gateway project
menu "NMEA Gateway config"
    config CAN_TX_IDX
        int "GPIO of NMEA2000/CAN TX"
        default 5
        help
            The GPIO of the NMEA2000/CAN transmitter
    config CAN_RX_IDX
        int "GPIO of NMEA2000/CAN RX"
        default 6
        help
            The GPIO of the NMEA2000/CAN receiver
endmenu
```
